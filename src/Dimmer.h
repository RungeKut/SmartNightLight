/******************************************************************
 * Dimmer.h — перевод «яркости» в скважность ШИМ
 *
 * ПОЧЕМУ ЛИНЕЙНЫЙ ШИМ ВЫГЛЯДИТ НЕРАВНОМЕРНО
 *
 * Глаз воспринимает свет примерно как корень из мощности. Поэтому при
 * линейной скважности первые деления ползунка дают резкие скачки, а
 * верхняя половина хода почти не отличается на глаз: от 200 до 255
 * разница едва заметна, а от 1 до 10 — как день и ночь.
 *
 * Лечится обратным преобразованием: duty = (level / 255) ^ gamma.
 * При gamma около 2.2 равные шаги ползунка дают равные шаги
 * воспринимаемой яркости.
 *
 * ПОЧЕМУ ОДНОЙ ПАРАБОЛЫ МАЛО
 *
 * Парабола (gamma = 2) — правильная идея, но при 8-битном ШИМ она
 * упирается в разрядность: нижние деления ползунка дают скважность
 * 0, 0, 0, 1, 1, 2 — то есть мёртвую зону в начале хода и грубые
 * ступени сразу за ней. Кривая ни при чём, не хватает именно шагов.
 *
 * Поэтому здесь два изменения сразу: кривая И 10-битный ШИМ. 1024
 * градации вместо 256 дают запас как раз там, где кривая сжимает
 * шкалу — внизу.
 *
 * ПОЧЕМУ ДНО ПОДНЯТО
 *
 * Чистая степенная функция отправляет малые значения в ноль:
 * (3/255)^2.2 * 1023 ≈ 0.06, то есть светодиод гаснет там, где логика
 * просила «еле тлеть». Любое ненулевое значение яркости обязано
 * что-то зажигать, поэтому кривая начинается не с нуля, а с
 * PWM_MIN_DUTY. Ноль остаётся нулём — это «погашен».
 ******************************************************************/

#ifndef Dimmer_h
#define Dimmer_h

#include <stdint.h>
#include <math.h>

// 10 бит: 0..1023
#define PWM_BITS 10
#define PWM_MAX_DUTY 1023

// Наименьшая ненулевая скважность. Подобрана так, чтобы светодиод
// уже светился, но едва-едва.
#define PWM_MIN_DUTY 2

// Гамма хранится целым, умноженным на 10: 22 = 2.2. Так она влезает
// в байт EEPROM и не тянет за собой float в настройки.
#define GAMMA_X10_DEFAULT 22
#define GAMMA_X10_MIN 10   // 1.0 — линейно, как было раньше
#define GAMMA_X10_MAX 30   // 3.0 — сильнее, чем обычно нужно

class Dimmer {
private:
  uint16_t _table[256];
  uint8_t _gammaX10;

public:
  Dimmer() : _gammaX10(0) { setGamma(GAMMA_X10_DEFAULT); }

  // Пересчитывает таблицу. 256 вызовов powf занимают единицы
  // миллисекунд и случаются только при старте и смене настройки.
  void setGamma(uint8_t gammaX10) {
    if (gammaX10 < GAMMA_X10_MIN) gammaX10 = GAMMA_X10_MIN;
    if (gammaX10 > GAMMA_X10_MAX) gammaX10 = GAMMA_X10_MAX;
    if (_gammaX10 == gammaX10) return;
    _gammaX10 = gammaX10;

    float g = gammaX10 / 10.0f;
    _table[0] = 0;
    for (int i = 1; i <= 255; i++) {
      float ratio = powf((float)i / 255.0f, g);
      float duty = PWM_MIN_DUTY + (PWM_MAX_DUTY - PWM_MIN_DUTY) * ratio;
      if (duty < PWM_MIN_DUTY) duty = PWM_MIN_DUTY;
      if (duty > PWM_MAX_DUTY) duty = PWM_MAX_DUTY;
      _table[i] = (uint16_t)(duty + 0.5f);
    }
  }

  uint16_t duty(uint8_t level) const { return _table[level]; }
  uint8_t gammaX10() const { return _gammaX10; }
};

#endif
